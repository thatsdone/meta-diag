## conf/layer.conf
```bitbake
# We have a conf and classes directory, add to BBPATH
BBPATH .= ":${LAYERDIR}"

# We have recipes-* directories, add to BBFILES
BBFILES += "${LAYERDIR}/recipes-*/*/*.bb \
            ${LAYERDIR}/recipes-*/*/*.bbappend"

BBFILE_COLLECTIONS += "meta-diag"
BBFILE_PATTERN_meta-diag = "^${LAYERDIR}/"
BBFILE_PRIORITY_meta-diag = "6"

LAYERDEPENDS_meta-diag = "core"
LAYERSERIES_COMPAT_meta-diag = "scarthgap wrynose"
```
